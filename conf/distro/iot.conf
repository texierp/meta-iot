## conf/distro/iot.conf
```bitbake
require conf/distro/poky.conf

DISTRO = "iot"
DISTRO_NAME = "IOT powered by Yocto/OE (Welcome to Bordeaux)"
DISTROOVERRIDES = "poky:iot"
SDK_VENDOR = "-iotsdk"
SDK_VERSION := "${@'${DISTRO_VERSION}'.replace('snapshot-${DATE}','snapshot')}"

MAINTAINER = "Pierre-Jean TEXIER <texier.pj2@gmail.com>"


# Toolchain configuration
# =======================

#TCLIBC = "musl"

# DISTRO FEATURES
# ===============

# DISTRO_FEATURES_remove ?= "opengl wayland x11 3g nfc pulseaudio zeroconf"

# Kernel configuration
# ====================

# NXP
# PREFERRED_VERSION_linux-fslc-imx = "4.1%"

# System configuration
# ====================

# VIRTUAL-RUNTIME_init_manager ?= "sysvinit"
#VIRTUAL-RUNTIME_init_manager = "systemd"
#DISTRO_FEATURES_remove = "sysvinit"
#DISTRO_FEATURES_append = " systemd"
#DISTRO_FEATURES_BACKFILL_CONSIDERED = " sysvinit"

PREFERRED_PROVIDER_jpeg = "jpeg"
PREFERRED_PROVIDER_jpeg-native = "jpeg-native"
```

## conf/layer.conf
```bitbake
# We have a conf and classes directory, add to BBPATH
BBPATH .= ":${LAYERDIR}"

# We have recipes-* directories, add to BBFILES
BBFILES += "${LAYERDIR}/recipes-*/*/*.bb \
	${LAYERDIR}/recipes-*/*/*.bbappend"

BBFILE_COLLECTIONS += "iot"
BBFILE_PATTERN_iot = "^${LAYERDIR}/"
BBFILE_PRIORITY_iot = "6"
```
